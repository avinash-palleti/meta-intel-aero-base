## conf/layer.conf
```bitbake
# We have a conf and classes directory, add to BBPATH
BBPATH .= ":${LAYERDIR}"

# We have recipes-* directories, add to BBFILES
BBFILES += "${LAYERDIR}/recipes-*/*/*.bb \
            ${LAYERDIR}/recipes-*/*/*.bbappend"

BBFILE_COLLECTIONS += "intel-aero-base"
BBFILE_PATTERN_intel-aero-base = "^${LAYERDIR}/"
BBFILE_PRIORITY_intel-aero-base = "7"
LAYERVERSION_intel-aero-base = "0"
```

## conf/machine/include/acpi.inc
```bitbake
# Include additional ACPI tables with the initrd
EXTRA_IMAGEDEPENDS_append = " acpi-tables"
INITRD_LIVE_prepend = "${DEPLOY_DIR_IMAGE}/acpi-tables.cpio "

IMAGE_INSTALL_append = " acpidump"
```
